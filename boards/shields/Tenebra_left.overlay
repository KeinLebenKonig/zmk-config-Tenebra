/ {
    ks_left: keymap {
        compatible = "zmk,direct-wiring";
        input-gpios = <
            &gpio0 24 (GPIO_ACTIVE_LOW | GPIO_PULL_UP)
            &gpio0 22 (GPIO_ACTIVE_LOW | GPIO_PULL_UP)
            &gpio0 29 (GPIO_ACTIVE_LOW | GPIO_PULL_UP)
            &gpio0 31 (GPIO_ACTIVE_LOW | GPIO_PULL_UP)
            &gpio0 8  (GPIO_ACTIVE_LOW | GPIO_PULL_UP)
            &gpio1 11 (GPIO_ACTIVE_LOW | GPIO_PULL_UP)
            &gpio0 11 (GPIO_ACTIVE_LOW | GPIO_PULL_UP)
            &gpio1 15 (GPIO_ACTIVE_LOW | GPIO_PULL_UP)
            &gpio1 0  (GPIO_ACTIVE_LOW | GPIO_PULL_UP)
            &gpio0 2  (GPIO_ACTIVE_LOW | GPIO_PULL_UP)
            &gpio0 9  (GPIO_ACTIVE_LOW | GPIO_PULL_UP)
            &gpio1 13 (GPIO_ACTIVE_LOW | GPIO_PULL_UP)
            &gpio0 10 (GPIO_ACTIVE_LOW | GPIO_PULL_UP)
            &gpio1 4  (GPIO_ACTIVE_LOW | GPIO_PULL_UP)
            &gpio1 6  (GPIO_ACTIVE_LOW | GPIO_PULL_UP)
            &gpio1 1  (GPIO_ACTIVE_LOW | GPIO_PULL_UP)
            &gpio1 2  (GPIO_ACTIVE_LOW | GPIO_PULL_UP)
            &gpio1 7  (GPIO_ACTIVE_LOW | GPIO_PULL_UP)
        >;
    };

    nice_view: nice_view@3c {
        compatible = "zmk,nice-view";
        label = "NiceView";
        status = "okay";
        reg = <0x3c>;
        width = <128>;
        height = <32>;
        segment-offset = <0>;
        page-offset = <0>;
        flip = <0>;
        invert = <0>;
    };

    zmk,splits {
        compatible = "zmk,split";
        central;
    };
};
