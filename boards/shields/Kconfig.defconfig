## boards/shields/Kconfig.defconfig
```kconfig
if SHIELD_TENEBRA_LEFT

config ZMK_KEYBOARD_NAME
	default "Tenebra"

config ZMK_SPLIT_ROLE_CENTRAL
	default y

endif

if SHIELD_TENEBRA_LEFT || SHIELD_TENEBRA_RIGHT

config ZMK_SPLIT
	default y

endif
```

## boards/shields/Kconfig.shield
```kconfig
# No whitespace after the comma or in your part name!
config SHIELD_TENEBRA_LEFT
    def_bool $(shields_list_contains,Tenebra_left)

# No whitespace after the comma or in your part name!
config SHIELD_TENEBRA_RIGHT
    def_bool $(shields_list_contains,Tenebra_right)
```
