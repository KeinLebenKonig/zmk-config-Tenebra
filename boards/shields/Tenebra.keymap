/*
 * Copyright (c) 2020 The ZMK Contributors
 *
 * SPDX-License-Identifier: MIT
 */

#include <behaviors.dtsi>
#include <dt-bindings/zmk/keys.h>
#include <dt-bindings/zmk/bt.h>

/ {
    behaviors {
        hm: homerow_mods {
            compatible = "zmk,behavior-hold-tap";
            label = "HOMEROW_MODS";
            #binding-cells = <2>;
            tapping-term-ms = <250>;
            quick-tap-ms = <0>;
            flavor = "tap-preferred";
            bindings =
                <&kp>,
                <&kp>;
        };
    };

        combos {
        compatible = "zmk,combos";
        esc_combo {
            key-positions = <15 16>;
            layers = <0>;
            bindings = <&kp ESC>;
        };
        colon_combo {
            key-positions = <19 20>;
            layers = <0>;
            bindings = <&kp COLN>;
        };
        tab_combo {
            key-positions = <42 43>;
            layers = <0>;
            bindings = <&kp TAB>;
        };
        del_combo {
            key-positions = <40 41>;
            layers = <0>;
            bindings = <&kp DEL>;
        };
        gaming_layer_toggle_combo {
            key-positions = <1 2 3>;
            bindings = <&tog 3>;
        };
        osrs_layer_toggle_combo {
            key-positions = <6 7 8>;
            bindings = <&tog 4>;
        };
        helldivers_layer_toggle
            key-positions = <11 12 13>;
            bindings = <&tog 5>;
        };
        hd_primary {
            key-positions = <3 16>;
            layers = <5>;
            bindings = <&kp KP_N1>;
        };
        hd_secondary {
            key-positions = <8 16>;
            layers = <5>;
            bindings = <&kp KP_N2>;
        };
        hd_support {
            key-positions = <13 16>;
            layers = <5>;
            bindings = <&kp KP_N3>;
        };
        hd_drop {
            key-positions = <4 16>;
            layers = <5>;
            bindings = <&kp KP_N5>;
        };
    };

    keymap {
        compatible = "zmk,keymap";

        layer0 {
            display-name = "Base"
            bindings = <
	//╭───────────────┬───────────────┬───────────────┬───────────────┬───────────────╮   ╭───────────────┬───────────────┬───────────────┬───────────────┬───────────────╮
        //│       Q       │       W       │       E       │       R       │       T       │   │       Y       │       U       │       I       │       O       │       P       │
                &kp Q           &kp W           &kp E           &kp R           &kp T               &kp Y           &kp U           &kp I           &kp O           &kp P
        //├───────────────┼───────────────┼───────────────┼───────────────┼───────────────┤   ├───────────────┼───────────────┼───────────────┼───────────────┼───────────────┤
        //│       A       │    S/CTRL     │    D/ALT      │    F/GUI      │       G       │   │       H       │    J/GUI      │    K/ALT      │    L/CTRL     │       ;       │
                &kp A        &hm LCTRL S     &hm LALT D      &hm LGUI F         &kp G               &kp H        &hm LGUI J      &hm LALT K      &hm LCTRL L      &kp SEMI
        //├───────────────┼───────────────┼───────────────┼───────────────┼───────────────┤   ├───────────────┼───────────────┼───────────────┼───────────────┼───────────────┤
        //│       Z       │       X       │       C       │       V       │       B       │   │       N       │       M       │       ,       │       .       │       /       │
                &kp Z           &kp X           &kp C           &kp V           &kp B               &kp N           &kp M         &kp COMMA        &kp DOT        &kp SLASH
        //╰───────────────┴───────────────┼───────────────┼───────────────┼───────────────┤   ├───────────────┼───────────────┼───────────────┼───────────────┴───────────────╯
                                                &mo 1       &kp BACKSPACE  &kp LEFT_SHIFT         &kp ENTER       &kp SPACE        &mo    2
        //                                ╰───────────────┴───────────────┴───────────────╯   ╰───────────────┴───────────────┴───────────────╯
            >;
        };

        layer1 {
	    display-name = "Symbols"
            bindings = <
	//╭───────────────┬───────────────┬───────────────┬───────────────┬───────────────╮   ╭───────────────┬───────────────┬───────────────┬───────────────┬───────────────╮
        //│       <       │       >       │       [       │       ]       │       `       │   │       ^       │       '       │       "       │       ?       │       /       │
	       &kp LT          &kp GT    &kp LBKT            &kp RBKT        &kp GRAVE           &kp CARET        &kp SQT         &kp DQT        &kp QMARK       &kp FSLH
        //├───────────────┼───────────────┼───────────────┼───────────────┼───────────────┤   ├───────────────┼───────────────┼───────────────┼───────────────┼───────────────┤
        //│       $       │       +       │       (       │       )       │       @       │   │      PIPE     │       -       │       =       │       _       │       *       │
                &kp DOLLAR     &kp PLUS       &kp LPAR        &kp RPAR       &kp AT_SIGN           &kp PIPE       &kp MINUS       &kp EQUAL       &kp UNDER     &kp ASTERISK
        //├───────────────┼───────────────┼───────────────┼───────────────┼───────────────┤   ├───────────────┼───────────────┼───────────────┼───────────────┼───────────────┤
        //│       !       │       #       │       {       │       }       │       ~       │   │       &       │       ;       │       :       │       %       │       \       │
              &kp EXCL        &kp HASH        &kp LBRC        &kp RBRC        &kp TILDE         &kp AMPERSAND   &kp SEMICOLON     &kp COLON       &kp PERCENT     &kp BSLH
        //╰───────────────┴───────────────┼───────────────┼───────────────┼───────────────┤   ├───────────────┼───────────────┼───────────────┼───────────────┴───────────────╯
                                               &trans       &kp BACKSPACE     &kp DELETE            &kp TAB        &kp SPACE        &trans
        //                                ╰───────────────┴───────────────┴───────────────╯   ╰───────────────┴───────────────┴───────────────╯
            >;
        };


        layer2 {
            display-name = "Numpad+Nav"
            bindings = <
        //╭───────────────┬───────────────┬───────────────┬───────────────┬───────────────╮   ╭───────────────┬───────────────┬───────────────┬───────────────┬───────────────╮
        //│               │       7       │       8       │       9       │       .       │   │     PGUP      │   CTRL+LEFT   │     HOME      │      END      │   CTRL+RIGHT  │
                &none          &kp N7          &kp N8          &kp N9          &kp DOT            &kp PG_UP      &kp LC(LEFT)     &kp HOME         &kp END      &kp LC(RIGHT)
        //├───────────────┼───────────────┼───────────────┼───────────────┼───────────────┤   ├───────────────┼───────────────┼───────────────┼───────────────┼───────────────┤
        //│       :       │       4       │       5       │       6       │       0       │   │    CTRL+UP    │      LEFT     │     DOWN      │      UP       │     RIGHT     │
              &kp COLON        &kp N4          &kp N5          &kp N6          &kp N0             &kp LC(UP)       &kp LEFT       &kp DOWN         &kp UP         &kp RIGHT
        //├───────────────┼───────────────┼───────────────┼───────────────┼───────────────┤   ├───────────────┼───────────────┼───────────────┼───────────────┼───────────────┤
        //│               │       1       │       2       │       3       │               │   │      PGDN     │    A+G+LEFT   │    A+G+DOWN   │     A+G+UP    │    A+G+RIGHT  │
               &none          &kp N1           &kp N2          &kp N3           &none             &kp PG_DN   &kp LA(LG(LEFT)) &kp LA(LG(DOWN)) &kp LA(LG(UP)) &kp LA(LG(RIGHT))
        //╰───────────────┴───────────────┼───────────────┼───────────────┼───────────────┤   ├───────────────┼───────────────┼───────────────┼───────────────┴───────────────╯
                                                &trans         &none            &none              &none            &none           &trans
        //                                ╰───────────────┴───────────────┴───────────────╯   ╰───────────────┴───────────────┴───────────────╯
            >;
        };


        layer3 {
	    display-name = "Gaming"
            bindings = <
        //╭───────────────┬───────────────┬───────────────┬───────────────┬───────────────╮   ╭───────────────┬───────────────┬───────────────┬───────────────┬───────────────╮
	//│      TAB      │       Q       │       W       │       E       │       R       │   │               │               │               │               │               │
               &kp TAB          &kp Q           &kp W           &kp E           &kp R               &none           &none           &none           &none           &none
        //├───────────────┼───────────────┼───────────────┼───────────────┼───────────────┤   ├───────────────┼───────────────┼───────────────┼───────────────┼───────────────┤
        //│     SHIFT     │       A       │       S       │       D       │       F       │   │               │               │               │               │               │
               &kp LSFT         &kp A           &kp S           &kp D           &kp F               &none           &none           &none           &none           &none
        //├───────────────┼───────────────┼───────────────┼───────────────┼───────────────┤   ├───────────────┼───────────────┼───────────────┼───────────────┼───────────────┤
        //│      LALT     │       Z       │       X       │       C       │       V       │   │               │               │               │               │               │
               &kp LALT         &kp Z           &kp X           &kp C           &kp V               &none           &none           &none           &none           &none
        //╰───────────────┴───────────────┼───────────────┼───────────────┼───────────────┤   ├───────────────┼───────────────┼───────────────┼───────────────┴───────────────╯
                                                &none         &kp SPACE       &kp LCTRL             &none           &none           &none
        //                                ╰───────────────┴───────────────┴───────────────╯   ╰───────────────┴───────────────┴───────────────╯
            >;
        };



        layer4 {
	    display-name = "OSRS"
            bindings = <
        //╭───────────────┬───────────────┬───────────────┬───────────────┬───────────────╮   ╭───────────────┬───────────────┬───────────────┬───────────────┬───────────────╮
	//|       4       |       3       |       2       |       1       |               |   |       .       |       7       |       8       |       9       |               |
                &kp N4          &kp N3          &kp N2          &kp N1          &none              &kp DOT          &kp N7          &kp N8          &kp N9          &none
        //├───────────────┼───────────────┼───────────────┼───────────────┼───────────────┤   ├───────────────┼───────────────┼───────────────┼───────────────┼───────────────┤
        //|      F4       |      F3       |      F2       |      F1       |      ESC      |   |       0       |       4       |       5       |       6       |               |
               &kp F4          &kp F3          &kp F2          &kp F1          &kp ESC              &kp N0          &kp N4          &kp N5          &kp N6          &none
        //├───────────────┼───────────────┼───────────────┼───────────────┼───────────────┤   ├───────────────┼───────────────┼───────────────┼───────────────┼───────────────┤
        //|               |               |               |      F5       |     SHIFT     |   |               |       1       |       2       |       3       |               |
                &none           &none           &none          &kp F5         &kp LSHIFT            &none           &kp N1          &kp N2          &kp N3          &none
        //╰───────────────┴───────────────┼───────────────┼───────────────┼───────────────┤   ├───────────────┼───────────────┼───────────────┼───────────────┴───────────────╯
                                                &none         &kp SPACE       &kp LCTRL             &none         &kp ENTER         &none
        //                                ╰───────────────┴───────────────┴───────────────╯   ╰───────────────┴───────────────┴───────────────╯
            >;
        };

        layer5 {
	    display-name = "Helldivers"
            bindings = <
        //╭───────────────┬───────────────┬───────────────┬───────────────┬───────────────╮   ╭───────────────┬───────────────┬───────────────┬───────────────┬───────────────╮
        //│      MAP      │     PING      │      UP       │    INTERACT   │    RELOAD     │   │               │               │               │               │               │
               &kp TAB          &kp Q           &kp W           &kp E           &kp R               &none           &none           &none           &none           &none
        //├───────────────┼───────────────┼───────────────┼───────────────┼───────────────┤   ├───────────────┼───────────────┼───────────────┼───────────────┼───────────────┤
        //│     MELEE     │     LEFT      │     DOWN      │     RIGHT     │    GRENADE    │   │               │               │               │               │               │
                &kp F          &kp A           &kp S            &kp D           &kp G               &none           &none           &none           &none           &none
        //├───────────────┼───────────────┼───────────────┼───────────────┼───────────────┤   ├───────────────┼───────────────┼───────────────┼───────────────┼───────────────┤
        //│      DIVE     │     PRONE     │    CROUCH     │     STIM      │     EMOTE     │   │               │               │               │               │               │
               &kp LALT         &kp Z           &kp C           &kp V           &kp B               &none           &none           &none           &none           &none
        //╰───────────────┴───────────────┼───────────────┼───────────────┼───────────────┤   ├───────────────┼───────────────┼───────────────┼───────────────┴───────────────╯
                                              &kp LCTRL       &kp LSHIFT      &kp SPACE             &none           &none           &none
        //                                ╰───────────────┴───────────────┴───────────────╯   ╰───────────────┴───────────────┴───────────────╯
            >;
        };

        layer6 {
	    display-name = "FN+BT"
            bindings = <
        //WIP BLUETOOTH STUFF
        // Needs an entrypoint, needs acutally defined bluetooth settings
        //╭───────────────┬───────────────┬───────────────┬───────────────┬───────────────╮   ╭───────────────┬───────────────┬───────────────┬───────────────┬───────────────╮
        //│               │      F7       │      F8       │      F9       │      F10      │   │     PGUP      │   CTRL+LEFT   │     HOME      │      END      │   CTRL+RIGHT  │
                &none          &kp F7          &kp F8          &kp F9          &kp F10          &none            &none              &none            &none      &none
        //├───────────────┼───────────────┼───────────────┼───────────────┼───────────────┤   ├───────────────┼───────────────┼───────────────┼───────────────┼───────────────┤
        //│               │      F4       │      F5       │      F6       │      F11      │   │    CTRL+UP    │      LEFT     │     DOWN      │      UP       │     RIGHT     │
                &none          &kp F4          &kp F5          &kp F6          &kp F11         &none            &none              &none            &none      &none
        //├───────────────┼───────────────┼───────────────┼───────────────┼───────────────┤   ├───────────────┼───────────────┼───────────────┼───────────────┼───────────────┤
        //│               │      F1       │      F2       │      F3       │      F12      │   │      PGDN     │    A+G+LEFT   │    A+G+DOWN   │     A+G+UP    │    A+G+RIGHT  │
                &none         &kp F1           &kp F2          &kp F3          &kp F12          &none            &none              &none            &none      &none
        //╰───────────────┴───────────────┼───────────────┼───────────────┼───────────────┤   ├───────────────┼───────────────┼───────────────┼───────────────┴───────────────╯
                                                &none          &none            &none              &none            &none           &none
        //                                ╰───────────────┴───────────────┴───────────────╯   ╰───────────────┴───────────────┴───────────────╯
            >;
        };
    };
};
